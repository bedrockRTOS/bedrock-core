## boards/qemu-riscv32-virt/defconfig
```kconfig
CONFIG_MAX_TASKS=16
CONFIG_NUM_PRIORITIES=8
CONFIG_DEFAULT_STACK_SIZE=1024
CONFIG_TICKLESS=y
CONFIG_RR_TIME_SLICE_US=10000
CONFIG_ASSERT=y
CONFIG_ARCH_RISCV32=y
CONFIG_SYS_CLOCK_HZ=10000000
```

## boards/rpi-pico/defconfig
```kconfig
CONFIG_MAX_TASKS=16
CONFIG_NUM_PRIORITIES=8
CONFIG_DEFAULT_STACK_SIZE=1024
CONFIG_TICKLESS=y
CONFIG_RR_TIME_SLICE_US=10000
CONFIG_ASSERT=y
CONFIG_ARCH_ARM_CORTEX_M0PLUS=y
CONFIG_SYS_CLOCK_HZ=12000000
```
