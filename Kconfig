## Kconfig
```kconfig
mainmenu "bedrock[RTOS] Configuration"

config MAX_TASKS
    int "Maximum number of tasks"
    default 16
    range 2 256
    help
      Maximum number of tasks that can be created.
      Each task consumes one TCB slot from a statically
      allocated array.

config NUM_PRIORITIES
    int "Number of priority levels"
    default 8
    range 2 32
    help
      Number of distinct priority levels (0 = highest).
      The idle task always runs at the lowest priority.

config DEFAULT_STACK_SIZE
    int "Default task stack size (bytes)"
    default 1024
    range 128 65536
    help
      Default stack size for tasks when not specified
      at creation time. Also used for the idle task.

config TICKLESS
    bool "Enable tickless operation"
    default y
    help
      When enabled, the kernel uses one-shot hardware
      timer alarms instead of periodic ticks. Reduces
      power consumption and improves timing accuracy.

config RR_TIME_SLICE_US
    int "Round-robin time slice (microseconds)"
    default 10000
    range 100 1000000
    help
      Time slice duration for round-robin scheduling among
      tasks of the same priority. When a task runs for this
      duration, it will be preempted and moved to the end
      of its priority queue. Set to 10000 (10ms) by default.

config ASSERT
    bool "Enable br_assert() checks"
    default y
    help
      When enabled, br_assert(expr) evaluates the expression
      and calls BR_PANIC() if it is false, halting the system.
      Disable to eliminate assertion overhead in production
      builds (the expression is still evaluated for side-effects).

config UART_RX_BUF_SIZE
    int "UART receive buffer size (bytes)"
    default 64
    range 4 1024
    help
      Size of the ring buffer that the UART receive interrupt fills
      and br_uart_getc() reads from. Bytes that arrive while the
      buffer is full are dropped.

config SHELL_LINE_MAX
    int "Shell line length (bytes)"
    default 64
    range 8 256
    help
      Size of the line buffer used by br_shell_run(), including the
      terminating zero. Characters typed past the limit are ignored.

config SHELL_MAX_ARGS
    int "Shell maximum arguments"
    default 8
    range 1 32
    help
      Maximum number of words, including the command name, that
      br_shell_execute() splits a line into. Longer lines are
      rejected with "too many arguments".

config TASK_STATS
    bool "Per-task CPU time accounting"
    default y
    help
      When enabled, the scheduler adds the time each task spends
      running to a per-task counter on every context switch. The
      counter is reported by br_task_get_info() and the shell
      "tasks" command. Costs one 64-bit field per task and one timer
      read per context switch.

config FS_NAME_MAX
    int "File name buffer size (bytes)"
    default 24
    range 8 64
    help
      Size of the file name field in the filesystem, including the
      terminating zero. Must be a multiple of 4. Longer names are
      rejected by br_fs_open().

config FS_BLOCK_MAX
    int "Largest filesystem block size (bytes)"
    default 512
    range 64 65536
    help
      Size of the static buffer that the single writer uses. A block
      device with a larger block size cannot be mounted.

config FS_MAX_BLOCKS
    int "Largest filesystem block count"
    default 256
    range 8 65536
    help
      Number of blocks the in-RAM free map covers, one bit per block.
      A block device with more blocks cannot be mounted.

config FS_MAX_OPEN
    int "Maximum open files"
    default 4
    range 1 32
    help
      Size of the static file descriptor table.

config MPU
    bool "Memory protection and user tasks"
    default n
    help
      When enabled, the kernel programs the memory protection unit
      (MPU on Cortex-M, PMP on RISC-V, paging on x86) and tasks can
      be created as unprivileged with br_task_create_user(). An
      unprivileged task can only touch its own stack, the shared
      user data section and the regions granted to it, and reaches
      the kernel through system calls. A task that breaks the rules
      is stopped and the system keeps running.

config MAX_USER_TASKS
    int "Maximum unprivileged tasks"
    default 4
    range 1 32
    depends on MPU
    help
      Number of unprivileged tasks. Each one gets a kernel stack for
      its system calls.

config USER_OBJECTS
    int "Kernel objects per type for unprivileged tasks"
    default 8
    range 1 64
    depends on MPU
    help
      Number of semaphores, mutexes and message queues that
      unprivileged tasks can create, each type counted separately.

config USER_MQ_ARENA
    int "Message queue buffer arena (bytes)"
    default 512
    range 64 16384
    depends on MPU
    help
      Memory that the message queues of unprivileged tasks are carved
      from. It is never given back.

config KSTACK_SIZE
    int "Kernel stack of an unprivileged task (bytes)"
    default 768
    range 256 4096
    depends on MPU
    help
      Stack that system calls run on, one per unprivileged task.

menu "Hardware"

choice ARCH
    prompt "Target architecture"
    default ARCH_ARM_CORTEX_M

config ARCH_ARM_CORTEX_M
    bool "ARM Cortex-M"

config ARCH_ARM_CORTEX_M0PLUS
    bool "ARM Cortex-M0+ (RP2040)"

config ARCH_RISCV32
    bool "RISC-V (RV32)"

endchoice

config SYS_CLOCK_HZ
    int "System clock frequency (Hz)"
    default 16000000
    help
      The core clock frequency of the target MCU.
      Used by the HAL timer to compute microsecond timestamps.
      On RISC-V this is the mtime frequency (10 MHz on QEMU virt).

endmenu
```
